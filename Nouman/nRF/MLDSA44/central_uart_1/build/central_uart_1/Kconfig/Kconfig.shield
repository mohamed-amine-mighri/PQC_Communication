## Nouman/nRF/MLDSA44/peripheral_uart/build/Kconfig/boards/Kconfig.defconfig
```kconfig
# Load Zephyr board defconfig descriptions.
osource "C:/ncs/v3.3.3/zephyr/boards/nordic/nrf5340dk/Kconfig.defconfig"
```

## Nouman/nRF/SHAKE2f/peripheral_uart/build/Kconfig/boards/Kconfig
```kconfig
# Load Zephyr board Kconfig descriptions.
osource "C:/ncs/v3.3.3/zephyr/boards/nordic/nrf5340dk/Kconfig"
```
